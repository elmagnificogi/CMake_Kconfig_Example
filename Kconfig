## Kconfig
```kconfig
mainmenu "CMake-Kconfig Project Configuration"

config PROJECT_NAME
    string
    prompt "Project Name"
    default "Demo-project"
    help
      "The name of the project. This will be used to name the output files."

config PROJECT_VERSION
    string
    prompt "Project Version"
    default "0.9.4"
    help
      "The version of the project."

source "platform/Kconfig"
source "driver/Kconfig"
source "rtos/Kconfig"
source "module/Kconfig"
```

## driver/Kconfig
```kconfig
menu "Driver Configuration"
  config LED
      bool "LED"

  config Motor
      bool "Motor"
endmenu
```

## module/Kconfig
```kconfig
menu "Module Configuration"
  config MOTORS
      bool "MOTORS"
      #跨文件选择
      select NewModule2

  config MOTORS2
      bool "MOTORS2"
      #同文件选择
      select FLASH

  config FLASH
      bool "FLASH"

  config FLASH_Feature1
      bool "Flash Feature1"
      help
            "详细描述Flash Feature1"
        depends on FLASH
  config FLASH_Feature2
      bool "Flash Feature2"
      help
            "详细描述Flash Feature2"
        depends on FLASH

rsource "*/Kconfig"
endmenu
```

## module/NewModule/Kconfig
```kconfig
menu "New Module Configuration"
    config NewModule
        tristate "NewModule"

    choice
        prompt "Feature selection" if NewModule

        config Feature1
            bool "Feature 1"
            help
                "This is the first feature"
        config Feature2
            bool "Feature 2"
            help
                "This is the second feature"
    endchoice
    rsource "*/Kconfig"
endmenu
```

## module/NewModule/SubModule/Kconfig
```kconfig
menu "Sub Module Configuration"
    config SUBMODULE
        bool "Enable Sub Module"
        default n
        help
            Enable Sub Module

    choice
        prompt "Sub Feature selection" if SUBMODULE

        config Sub_Feature1
            bool "Sub_Feature1"
        config Sub_Feature2
            bool "Sub_Feature2"
    endchoice
endmenu
```

## module/NewModule2/Kconfig
```kconfig
menu "New Module2 Configuration"
    config NewModule2
        bool "NewModule2"

    if NewModule2
        choice
            prompt "Feature selection"

            config Feature11
                bool "Feature 11"
                help
                    "This is the first feature"
            config Feature22
                bool "Feature 22"
                help
                    "This is the second feature"
        endchoice
    endif
    rsource "*/Kconfig"
endmenu
```

## module/NewModule2/SubModule2/Kconfig
```kconfig
menu "Sub Module2 Configuration"
    config SubModule2
        bool "SubModule2"

    choice
        prompt "Feature selection"

        config Sub2_Feature1 
            bool "Sub2_Feature1" if SubModule2
            help
                "This is the first feature"
        config Sub2_Feature2
            bool "Sub2_Feature1" if SubModule2
            help
                "This is the second feature"
    endchoice
endmenu
```

## platform/Kconfig
```kconfig
menu "Platform Configuration"

    choice
        prompt "Platform Selection"
        default APM32F405

        config APM32F405
            bool "APM32F405"

        config STM32F103
            bool "STM32F103"

    endchoice
endmenu
```

## rtos/Kconfig
```kconfig
mainmenu "RTOS Configuration"

choice
    prompt "RTOS Selection"
    default FreeRTOS

config FreeRTOS
    bool "FreeRTOS"

config uCOS
    bool "uCOS"

endchoice
```
